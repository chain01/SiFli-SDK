## example/pm/bt/project/common/hcpu/Kconfig.tmp
```kconfig
source "D:/code/SiFli-SDK/customer/boards/em-lb525/hcpu/Kconfig.board"
source "$SIFLI_SDK/customer/boards/Kconfig.v2"
source "$SIFLI_SDK/Kconfig.v2"
rsource "Kconfig.proj"
```

## example/rt_device/pwm/pwm/project/Kconfig.tmp
```kconfig
source "D:/Users/zhenpengfu/Desktop/siflisdk/customer/boards/em-lb587/hcpu/Kconfig.board"
source "$SIFLI_SDK/customer/boards/Kconfig.v2"
source "$SIFLI_SDK/Kconfig.v2"
rsource "Kconfig.proj"
```

## middleware/audio/Kconfig
```kconfig
if !SOC_SF32LB55X
# Kconfig file for package WebRTC
menuconfig AUDIO
    bool "Enable Audio"
choice
    prompt "Select audio path Type"
        depends on AUDIO
    default AUDIO_PATH_USING_HCI
    config AUDIO_PATH_USING_HCPU
        bool "HCPU PATH"           
    config AUDIO_PATH_USING_LCPU
        bool "LCPU PATH"
    config AUDIO_PATH_USING_HCI
        bool "HCI PATH"
endchoice 
config AUDIO_PCM_PLC_ENABLE
    bool "Enable audio PCM PLC"
        depends on AUDIO
    default n
config AUDIO_USING_AUDPROC
    bool "Enable audio process framework"
        depends on AUDIO
    default y
config AUDIO_USING_MANAGER
    bool "Enable audio manager"
        depends on AUDIO && BF0_HCPU
    default y
config AUDIO_LOCAL_MUSIC
    bool "Enable local audio"
    depends on (AUDIO_USING_AUDPROC && AUDIO && AUDIO_USING_MANAGER && BF0_HCPU)
    select PKG_USING_LIBHELIX
    default n
config AUDIO_BT_AUDIO
    bool "Enable BT audio"
    depends on (AUDIO_USING_AUDPROC && AUDIO)
    default y
config PKG_USING_VBE_DRC
    bool "Enable Audio Virtual Bass Enhancement & DRC"
        depends on AUDIO
    select BSP_USING_CMSIS_DSP
    default n
config AUDIO_SOFTEQ
    bool "Enable audio software EQ"
        depends on AUDIO
    default n
config AUDIO_FREQSHIFT
    bool "Enable audio frequency shift"
        depends on AUDIO
    default n
 
config PKG_USING_SOUNDPLUS
    bool "Enable soundplus real-time speech enhancement processing"
        depends on AUDIO
    default n
config PKG_USING_AUDIO_TEST_API
    bool "mic speaker test api"
        depends on AUDIO
    default n
config PKG_USING_3MICS
    bool "total three Mics"
        depends on AUDIO
    default n

# for some proj.conf used
config AUDIO_SPEAKER_USING_CODEC
    bool "using cpu codec for tx"
        depends on AUDIO
    default y
config AUDIO_MIC_USING_CODEC
    bool "using cpu codec for rx"
        depends on AUDIO
    default y 

config MULTI_CLIENTS_AT_WORKING
    bool "multi audio app work together if no hardware conflict"
        depends on AUDIO
    default n
config SOFTWARE_TX_MIX_ENABLE
    bool "audio mix support(big memory footprint)"
        depends on MULTI_CLIENTS_AT_WORKING
    default n

if PKG_USING_3MICS
    config PKG_USING_3MICS_WITHOUT_ADC
    bool "only two pdm mic"
        depends on AUDIO
    default n

endif

endif
```
